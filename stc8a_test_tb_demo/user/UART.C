/*                        -- 渡河蚂蚁电子工作室 --                        */
/*
*   说    明: STC8A8KS4A12 DEMO程序
*   开发平台: STC15W408S     
*   淘宝网店: 
*
//  文件名：main.c                                                              
//  说明：供客户测试模块通信使用程序                                                                  
//  编写人员：Duhemayi                                                                   
//  编写日期：2018-09-16                                                               
//  程序维护：
//  维护记录：
//	版    本: V1.0
//                                                          
// 免责声明：该程序仅用于学习与交流 
// (c) Duhemayi Corporation. All rights reserved.     
******************************************************************************/
#include "uart.h"

bit busy;
char wptr;
char rptr;
char buffer[16];

/******************************************************************************/
// 函数名称：uart1Init 
// 输入参数：无 
// 输出参数：无 
// 函数功能：设置好定时器0的工作模式 
/******************************************************************************/
void Uart1Init(void)
{
    SCON = 0x50;	   //8位波特率，允许接收
    T2L = BRT;
    T2H = BRT >> 8;
    AUXR |= 0x15;
    wptr = 0x00;
    rptr = 0x00;
    busy = 0;
}

/******************************************************************************/
// 函数名称：uartSendData 
// 输入参数：ucData: 发送字节 
// 输出参数：无 
// 函数功能：使用串口发送一个字节数据 
/******************************************************************************/
void UartSend(uint8 dat)
{
    while (busy);
    busy = 1;
    SBUF = dat;
}

/******************************************************************************/
// 函数名称：uartSendString 
// 输入参数：pS: 字符串首地址 
// 输出参数：无 
// 函数功能：发送字符串通过串口输出 
/******************************************************************************/
void UartSendStr(uint8 *p)
{
    while (*p)
    {
        UartSend(*p++);
    }
}

/******************************************************************************/
// 函数名称：time0ISR 
// 输入参数：无 
// 输出参数：无 
// 函数功能：串口0服务函数 
/******************************************************************************/
void Uart1Isr() interrupt 4 using 1
{
    if (TI)
    {
        TI = 0;
        busy = 0;
    }
    if (RI)
    {
        RI = 0;
        buffer[wptr++] = SBUF;
        wptr &= 0x0f;
    }
}

/******************************************************************************/
// 函数名称：void UART1_IOPORT_CHANGE(void)
// 输入参数：无 
// 输出参数：无 
// 函数功能：串口一的IO口切换
/******************************************************************************/
void UART1_IOPORT_CHANGE(void)
{
    P_SW1 = 0x00;                               //RXD/P3.0, TXD/P3.1
//  P_SW1 = 0x40;                               //RXD_2/P3.6, TXD_2/P3.7
//  P_SW1 = 0x80;                               //RXD_3/P1.6, TXD_3/P1.7
//  P_SW1 = 0xc0;                               //RXD_4/P4.3, TXD_4/P4.4

}








